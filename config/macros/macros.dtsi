#define def_macro(name, ...) \
name: name { \
	compatible = "zmk,behavior-macro"; \
	#binding-cells = <0>; \
	bindings = <__VA_ARGS__>; \
}

macros {
	// Quote/space macros
	def_macro(m_dquo_space, &kp DQT &kp SPACE);
	def_macro(m_squo_space, &kp SQT &kp SPACE);
	def_macro(m_trem_space, &kp CARET &kp SPACE);
	def_macro(m_grave_space, &kp GRAVE &kp SPACE);
	def_macro(m_tilde_space, &kp TILDE &kp SPACE);
	
	// Pair macros with spacing
	def_macro(m_t_pairDquo, &kp DQT &kp SPACE &kp DQT &kp SPACE &kp LEFT);
	def_macro(m_t_pairSquo, &kp SQT &kp SPACE &kp SQT &kp SPACE &kp LEFT);
	def_macro(m_t_pairLtGt, &kp LT &kp GT &kp LEFT);
	
	// Basic pairs
	def_macro(m_pair_paren, &kp LPAR &kp RPAR &kp LEFT);
	def_macro(m_pair_brace, &kp LBRC &kp RBRC &kp LEFT);
	def_macro(m_pair_bracket, &kp LBKT &kp RBKT &kp LEFT);
	def_macro(m_code_block, &kp LBRC &kp RET &kp RET &kp RBRC &kp UP &kp END &kp TAB);

	// Programming symbols
	def_macro(m_arrow, &kp MINUS &kp GT);
	def_macro(m_arrow_double, &kp EQUAL &kp GT);
	def_macro(m_plus_eq, &kp PLUS &kp EQUAL);
	def_macro(m_minus_eq, &kp MINUS &kp EQUAL);
	def_macro(m_lte, &kp LT &kp EQUAL);
	def_macro(m_gte, &kp GT &kp EQUAL);
	def_macro(m_or_eq, &kp PIPE &kp EQUAL);
	def_macro(m_carriage_return, &kp BACKSLASH &kp R);
	def_macro(m_line_feed, &kp BACKSLASH &kp N);
	
	// BT
	def_macro(m_clr_bt1, &bt BT_SEL 1 &bt BT_CLR);
	def_macro(m_clr_bt2, &bt BT_SEL 2 &bt BT_CLR);
	def_macro(m_clr_bt3, &bt BT_SEL 3 &bt BT_CLR);
	def_macro(m_clr_bt4, &bt BT_SEL 4 &bt BT_CLR);
	
	#include "french.dtsi"
};
