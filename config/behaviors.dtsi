#define def_morph_shift(name, released, held) \
name: name { \
	compatible = "zmk,behavior-mod-morph"; \
	bindings = <released>, <held>; \
	#binding-cells = <0>; \
	mods = <(MOD_RSFT|MOD_LSFT)>; \
}

#define def_hold_tap(name, tap, hold) \
name: name { \
	compatible = "zmk,behavior-hold-tap"; \
	#binding-cells = <2>; \
	tapping-term-ms = <200>; \
	flavor = "tap-preferred"; \
	bindings = <hold>, <tap>; \
}

#define def_tap_dance(name, binding1, binding2) \
name: name { \
	compatible = "zmk,behavior-tap-dance"; \
	#binding-cells = <0>; \
	bindings = <binding1>, <binding2>; \
}

behaviors {
	b_hm: b_hm {
		compatible = "zmk,behavior-hold-tap";
		label = "HOMEROW_MODS_LEFT";
		#binding-cells = <2>;
		flavor = "balanced";
		hold-trigger-on-release;
		tapping-term-ms = <200>;
		quick-tap-ms = <55>;
		bindings = <&kp>, <&kp>;
	};
	
	def_morph_shift(b_CommaScoln, &kp COMMA, &kp SEMICOLON);
	def_morph_shift(b_DotColn, &kp DOT, &kp COLON);
	def_morph_shift(b_SlshStar, &kp FSLH, &kp STAR);
	def_morph_shift(b_HashDllr, &kp HASH, &kp DOLLAR);
	def_morph_shift(b_MinusPlus, &kp MINUS, &kp PLUS);
	def_morph_shift(b_ExclQuest, &kp EXCLAMATION, &kp QUESTION);
	def_morph_shift(b_BackspaceDelete, &kp BACKSPACE, &kp DELETE);

	def_morph_shift(b_Bt1, &bt BT_SEL 1, &m_clr_bt1);
	def_morph_shift(b_Bt2, &bt BT_SEL 2, &m_clr_bt2);
	def_morph_shift(b_Bt3, &bt BT_SEL 3, &m_clr_bt3);
	def_morph_shift(b_Bt4, &bt BT_SEL 4, &m_clr_bt4);
	
	def_tap_dance(b_Arrows, &m_arrow, &m_arrow_double);
	
    def_hold_tap(b_pair_dquo, &m_dquo_space, &m_t_pairDquo);
    def_hold_tap(b_pair_squo, &m_squo_space, &m_t_pairSquo);
	def_hold_tap(b_pair_brace, &kp LBRC, &m_pair_brace);
	def_hold_tap(b_pair_paren, &kp LPAR, &m_pair_paren);
	def_hold_tap(b_pair_bracket, &kp LBKT, &m_pair_bracket);
};